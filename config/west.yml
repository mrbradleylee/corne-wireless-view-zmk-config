## config/west.yml
```yaml
manifest:
  remotes:
    - name: mrbradleylee
      url-base: https://github.com/mrbradleylee
  projects:
    - name: zmk
      remote: mrbradleylee
      revision: main-with-native-mouse
      import: app/west.yml
  self:
    path: config
```
